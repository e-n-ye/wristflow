## apps/ota_boot/project/Kconfig.proj
```kconfig
config BF0_HCPU
    bool
    default y
config CFG_BOOTLOADER
    bool
    default y
config CUSTOM_MEM_MAP
    bool
    select custom_mem_map
    default y

config WF_OTA_PRODUCTION_BOOT
    bool
    default y if "$(WRISTFLOW_AB_BOOT)" = "1"
    select PKG_SIFLI_MBEDTLS_BOOT
```

## apps/ota_loader/project/Kconfig.proj
```kconfig
config BF0_HCPU
    bool
    default y

config CUSTOM_MEM_MAP
    bool
    select custom_mem_map
    default y

config WF_OTA_ANDROID_RECEIVER
    bool
    default y if "$(WRISTFLOW_OTA_RECEIVER)" = "1"
    select BLUETOOTH
    select BSP_USING_ADC1
    select BSP_BLE_SERIAL_TRANSMISSION
    select BLE_CM_BOND_DISABLE
    select PKG_USING_FLASHDB
    select BSP_USING_LCD
    select BSP_USING_EPIC
    select PKG_USING_LITTLEVGL2RTT
    select RT_USING_MEMHEAP
```
